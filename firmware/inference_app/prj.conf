## CMakeLists.txt
```
cmake_minimum_required(VERSION 3.20.0)

find_package(Zephyr REQUIRED HINTS $ENV{ZEPHYR_BASE})
project(rssi_inference)

target_sources(app PRIVATE
    src/main.c
    src/scanner.c
    src/inference.c
    src/model_weights.c
    src/leds.c
    src/ble_result_svc.c
)

# Model is a hand-rolled INT8 dense-layer forward pass over weights
# extracted from model/model_int8.tflite (see src/model_weights.c and the
# comment at the top of src/inference.c for why this isn't TFLite Micro).
# Regenerate src/model_weights.c after retraining - see model/README.md.
```

## prj.conf
```kconfig
# BLE observer (scan for the beacon) + peripheral (advertise the result
# service) at the same time.
CONFIG_BT=y
CONFIG_BT_OBSERVER=y
CONFIG_BT_PERIPHERAL=y
CONFIG_BT_DEVICE_NAME="rssi_classifier"
CONFIG_BT_SETTINGS=n

CONFIG_CONSOLE=y
CONFIG_UART_CONSOLE=y
CONFIG_PRINTK=y

CONFIG_GPIO=y

CONFIG_MAIN_STACK_SIZE=2048

# The classifier (src/inference.c) uses sqrtf/lroundf from libm.
CONFIG_FPU=y
```

## src/main.c
```c
#include <zephyr/kernel.h>
#include <zephyr/sys/printk.h>
#include <zephyr/bluetooth/bluetooth.h>

#include "scanner.h"
#include "leds.h"
#include "ble_result_svc.h"

int main(void)
{
	int err;

	printk("Starting RSSI distance classifier\n");

	err = leds_init();
	if (err) {
		printk("LED init failed (err %d)\n", err);
		return 0;
	}

	err = bt_enable(NULL);
	if (err) {
		printk("Bluetooth init failed (err %d)\n", err);
		return 0;
	}

	(void)ble_result_svc_start();
	(void)scanner_start();

	return 0;
}
```

## src/ble_result_svc.c
```c
/*
 * Custom GATT service: one characteristic that notifies subscribers with
 * the latest distance_bucket classification (single byte: 0=near, 1=mid,
 * 2=far, 3=unknown). Vendor-specific 128-bit UUIDs (randomly generated for
 * this project - regenerate your own if you fork this for something else).
 */

#include "ble_result_svc.h"

#include <zephyr/kernel.h>
#include <zephyr/sys/printk.h>
#include <zephyr/bluetooth/bluetooth.h>
#include <zephyr/bluetooth/gatt.h>
#include <zephyr/bluetooth/uuid.h>

/* 6e9b0001-... */
#define BT_UUID_RESULT_SVC_VAL \
	BT_UUID_128_ENCODE(0x6e9b0001, 0xb0f0, 0x4a6a, 0x9c9a, 0x000000000000)
#define BT_UUID_RESULT_CHRC_VAL \
	BT_UUID_128_ENCODE(0x6e9b0002, 0xb0f0, 0x4a6a, 0x9c9a, 0x000000000000)

static struct bt_uuid_128 result_svc_uuid = BT_UUID_INIT_128(BT_UUID_RESULT_SVC_VAL);
static struct bt_uuid_128 result_chrc_uuid = BT_UUID_INIT_128(BT_UUID_RESULT_CHRC_VAL);

static uint8_t last_bucket = DIST_UNKNOWN;
static bool notify_enabled;

static void result_ccc_cfg_changed(const struct bt_gatt_attr *attr, uint16_t value)
{
	ARG_UNUSED(attr);
	notify_enabled = (value == BT_GATT_CCC_NOTIFY);
}

static ssize_t read_result(struct bt_conn *conn, const struct bt_gatt_attr *attr,
			    void *buf, uint16_t len, uint16_t offset)
{
	ARG_UNUSED(conn);
	return bt_gatt_attr_read(conn, attr, buf, len, offset, &last_bucket, sizeof(last_bucket));
}

BT_GATT_SERVICE_DEFINE(result_svc,
	BT_GATT_PRIMARY_SERVICE(&result_svc_uuid),
	BT_GATT_CHARACTERISTIC(&result_chrc_uuid.uuid,
				BT_GATT_CHRC_READ | BT_GATT_CHRC_NOTIFY,
				BT_GATT_PERM_READ,
				read_result, NULL, &last_bucket),
	BT_GATT_CCC(result_ccc_cfg_changed, BT_GATT_PERM_READ | BT_GATT_PERM_WRITE),
);

static const struct bt_data ad[] = {
	BT_DATA_BYTES(BT_DATA_FLAGS, (BT_LE_AD_GENERAL | BT_LE_AD_NO_BREDR)),
	BT_DATA(BT_DATA_NAME_COMPLETE, CONFIG_BT_DEVICE_NAME, sizeof(CONFIG_BT_DEVICE_NAME) - 1),
};

int ble_result_svc_start(void)
{
	int err = bt_le_adv_start(BT_LE_ADV_CONN_FAST_1, ad, ARRAY_SIZE(ad), NULL, 0);

	if (err) {
		printk("Advertising failed to start (err %d)\n", err);
		return err;
	}
	printk("Advertising result service as \"%s\"\n", CONFIG_BT_DEVICE_NAME);
	return 0;
}

void ble_result_svc_notify(enum distance_bucket b)
{
	last_bucket = (uint8_t)b;

	if (!notify_enabled) {
		return;
	}
	bt_gatt_notify(NULL, &result_svc.attrs[1], &last_bucket, sizeof(last_bucket));
}
```

## src/ble_result_svc.h
```c
#ifndef BLE_RESULT_SVC_H_
#define BLE_RESULT_SVC_H_

#include "inference.h"

/* Starts advertising a custom GATT service with one notify characteristic
 * that broadcasts the latest distance_bucket classification.
 */
int ble_result_svc_start(void);

/* Call whenever a new classification is produced; notifies any subscribed
 * central. No-op if nobody is subscribed.
 */
void ble_result_svc_notify(enum distance_bucket b);

#endif /* BLE_RESULT_SVC_H_ */
```

## src/inference.c
```c
/*
 * INT8 forward pass for the distance-bucket classifier.
 *
 * What this file does
 *   Runs a quantized 3 -> 8 -> 8 -> 3 fully-connected network on a Cortex-M4F
 *   (nRF52840). Input is a short window of RSSI samples; the three features
 *   (latest RSSI, window mean, window standard deviation) are standardized,
 *   quantized to INT8, pushed through two ReLU dense layers, and a final
 *   linear layer whose argmax selects NEAR / MID / FAR. Weights and
 *   quantization parameters live in model_weights.c, generated from
 *   model/model_int8.tflite by model/extract_weights.py.
 *
 * Why a dedicated implementation instead of the TFLite Micro runtime
 *   The model has 131 parameters (112 weights, 19 biases). At that size a
 *   purpose-built forward pass is smaller than the interpreter, arena
 *   allocator and kernel registry TFLM would pull in, has no C++ runtime
 *   dependency, and is short enough to verify line by line against the
 *   reference implementation.
 *
 * Quantization scheme (TFLite-compatible)
 *   real_value = scale * (quantized_value - zero_point)
 *   Weights are per-output-channel symmetric (zero_point 0). Activations and
 *   the network input are per-tensor asymmetric. Biases are INT32 with
 *   scale = input_scale * weight_scale[channel], so they fold directly into
 *   the INT32 accumulator.
 *
 * Why float requantization
 *   TFLM requantizes with fixed-point multiplier/shift pairs so it can run on
 *   cores without an FPU. The Cortex-M4F has a single-precision hardware FPU,
 *   so scaling the INT32 accumulator by the real-valued combined scale is
 *   both simpler and at least as accurate as the fixed-point approximation.
 *
 * Verification
 *   - model/verify_inference/verify_inference.py is an independent Python
 *     port of this algorithm, checked against the official TFLite
 *     interpreter on every window in the dataset.
 *   - model/verify_inference/test_main.c builds this exact file natively
 *     (it is pure C with no Zephyr dependency, deliberately) and replays the
 *     dataset through classify_distance().
 */

#include "inference.h"
#include "model_weights.h"

#include <math.h>
#include <stdbool.h>
#include <stddef.h>
#include <stdint.h>

/* The enum and the model must agree on the number of real classes:
 * DIST_UNKNOWN is the first value past the last class the network can emit.
 */
_Static_assert(DIST_UNKNOWN == MODEL_NUM_CLASSES,
	       "enum distance_bucket and MODEL_NUM_CLASSES have drifted apart");

/**
 * Clamp a 32-bit value into the signed 8-bit range.
 *
 * @param v  Value to saturate.
 * @return   v limited to [INT8_MIN, INT8_MAX].
 */
static int8_t saturate_int8(int32_t v)
{
	if (v > INT8_MAX) {
		return INT8_MAX;
	}
	if (v < INT8_MIN) {
		return INT8_MIN;
	}
	return (int8_t)v;
}

/**
 * Quantize a real value to INT8: q = round(real / scale) + zero_point.
 *
 * @param real_value  Value to quantize.
 * @param scale       Tensor scale; must be non-zero.
 * @param zero_point  Tensor zero point.
 * @return            Quantized value, saturated to INT8.
 */
static int8_t quantize(float real_value, float scale, int32_t zero_point)
{
	return saturate_int8((int32_t)lroundf(real_value / scale) + zero_point);
}

/**
 * Compute one output channel of a dense layer as a real (float) value:
 *   sum_i (in[i] - in_zp) * w[c][i] * (in_scale * w_scale[c])
 *     + bias[c] * (in_scale * w_scale[c])
 *
 * The combined scale is computed once per channel and applied to both the
 * accumulator and the bias.
 *
 * @param in        Input activations, in_len INT8 values.
 * @param in_zp     Input zero point.
 * @param in_scale  Input scale.
 * @param in_len    Number of inputs.
 * @param w         Weights, row-major [out_len][in_len], INT8, zero point 0.
 * @param bias      INT32 biases, one per output channel.
 * @param w_scales  Per-output-channel weight scales.
 * @param c         Output channel index to compute.
 * @return          Dequantized pre-activation value for channel c.
 */
static float dense_channel_real(const int8_t *in, int32_t in_zp, float in_scale, size_t in_len,
				const int8_t *w, const int32_t *bias, const float *w_scales,
				size_t c)
{
	const float combined_scale = in_scale * w_scales[c];
	int32_t acc = 0;

	for (size_t i = 0; i < in_len; i++) {
		acc += (int32_t)(in[i] - in_zp) * (int32_t)w[c * in_len + i];
	}

	return (float)acc * combined_scale + (float)bias[c] * combined_scale;
}

/**
 * One INT8 dense layer with INT8 output, for hidden layers.
 * Each channel is dequantized, optionally ReLU-clamped at the output zero
 * point (the quantized representation of 0.0), and requantized.
 *
 * @param in         Input activations, in_len INT8 values.
 * @param in_zp      Input zero point.
 * @param in_scale   Input scale.
 * @param in_len     Number of inputs.
 * @param w          Weights, row-major [out_len][in_len].
 * @param bias       INT32 biases, one per output channel.
 * @param w_scales   Per-output-channel weight scales.
 * @param out_scale  Output tensor scale; must be non-zero.
 * @param out_zp     Output tensor zero point.
 * @param out_len    Number of outputs.
 * @param relu       Clamp negative results to zero before saturating.
 * @param out        Destination, out_len INT8 values.
 */
static void dense_layer(const int8_t *in, int32_t in_zp, float in_scale, size_t in_len,
			const int8_t *w, const int32_t *bias, const float *w_scales,
			float out_scale, int32_t out_zp, size_t out_len,
			bool relu, int8_t *out)
{
	for (size_t c = 0; c < out_len; c++) {
		float real = dense_channel_real(in, in_zp, in_scale, in_len, w, bias, w_scales, c);
		int32_t q = (int32_t)lroundf(real / out_scale) + out_zp;

		if (relu && q < out_zp) {
			q = out_zp;
		}
		out[c] = saturate_int8(q);
	}
}

/**
 * Final dense layer, producing float logits instead of INT8 activations.
 *
 * The logits are only ever compared against each other, so they are kept as
 * dequantized floats rather than requantized to INT8. Requantizing at a
 * coarse scale would round nearby logits to the same integer (2.3 and 2.4
 * both becoming 2) and let argmax pick the wrong class.
 *
 * @param in        Input activations, in_len INT8 values.
 * @param in_zp     Input zero point.
 * @param in_scale  Input scale.
 * @param in_len    Number of inputs.
 * @param w         Weights, row-major [out_len][in_len].
 * @param bias      INT32 biases, one per output channel.
 * @param w_scales  Per-output-channel weight scales.
 * @param out_len   Number of logits.
 * @param logits    Destination, out_len floats.
 */
static void dense_layer_logits(const int8_t *in, int32_t in_zp, float in_scale, size_t in_len,
			       const int8_t *w, const int32_t *bias, const float *w_scales,
			       size_t out_len, float *logits)
{
	for (size_t c = 0; c < out_len; c++) {
		logits[c] = dense_channel_real(in, in_zp, in_scale, in_len, w, bias, w_scales, c);
	}
}

/**
 * Classify a window of RSSI samples into a distance bucket.
 *
 * Features are [latest RSSI, window mean, window standard deviation],
 * matching the feature engineering in model/train.py.
 *
 * Preconditions: samples are in chronological order (most recent last).
 * Callers keeping a circular buffer must linearize it first.
 *
 * @param rssi_window  RSSI samples in dBm, oldest first.
 * @param n            Number of samples in rssi_window.
 * @return             The predicted bucket, or DIST_UNKNOWN if rssi_window is
 *                     NULL, n is 0, or the model's feature normalization is
 *                     invalid (a zero standard deviation entry).
 */
enum distance_bucket classify_distance(const float *rssi_window, size_t n)
{
	if (rssi_window == NULL || n == 0) {
		return DIST_UNKNOWN;
	}

	float sum = 0.0f;
	float sum_sq = 0.0f;

	for (size_t i = 0; i < n; i++) {
		sum += rssi_window[i];
	}
	const float mean = sum / (float)n;

	for (size_t i = 0; i < n; i++) {
		const float d = rssi_window[i] - mean;

		sum_sq += d * d;
	}
	/* Population standard deviation (divide by n, not n - 1) to match
	 * numpy's default np.std used for the training features in model/train.py.
	 */
	const float std = (n > 1) ? sqrtf(sum_sq / (float)n) : 0.0f;

	const float raw[MODEL_NUM_FEATURES] = {rssi_window[n - 1], mean, std};
	int8_t q_in[MODEL_NUM_FEATURES];

	for (size_t i = 0; i < MODEL_NUM_FEATURES; i++) {
		if (model_feature_std[i] == 0.0f) {
			return DIST_UNKNOWN;
		}

		const float normalized = (raw[i] - model_feature_mean[i]) / model_feature_std[i];

		q_in[i] = quantize(normalized, model_input_scale, model_input_zero_point);
	}

	const struct model_weights *m = &g_model_weights;

	int8_t a1[MODEL_L1_UNITS];
	dense_layer(q_in, model_input_zero_point, model_input_scale, MODEL_NUM_FEATURES,
		    m->l1_w, m->l1_b, m->l1_w_scales, *m->l1_act_scale, *m->l1_act_zp,
		    MODEL_L1_UNITS, true, a1);

	int8_t a2[MODEL_L2_UNITS];
	dense_layer(a1, *m->l1_act_zp, *m->l1_act_scale, MODEL_L1_UNITS,
		    m->l2_w, m->l2_b, m->l2_w_scales, *m->l2_act_scale, *m->l2_act_zp,
		    MODEL_L2_UNITS, true, a2);

	/* The trained model ends in softmax, but softmax is strictly monotonic
	 * across the class dimension, so the class with the largest pre-softmax
	 * logit is also the class with the largest probability. Taking argmax
	 * over the float logits therefore gives the same answer without
	 * evaluating exp() on-device.
	 */
	float logits[MODEL_NUM_CLASSES];
	dense_layer_logits(a2, *m->l2_act_zp, *m->l2_act_scale, MODEL_L2_UNITS,
			   m->l3_w, m->l3_b, m->l3_w_scales, MODEL_NUM_CLASSES, logits);

	size_t best = 0;

	for (size_t c = 1; c < MODEL_NUM_CLASSES; c++) {
		if (logits[c] > logits[best]) {
			best = c;
		}
	}
	return (enum distance_bucket)best;
}

/**
 * Human-readable name for a distance bucket.
 *
 * @param b  Bucket value.
 * @return   Static string: "NEAR", "MID", "FAR", or "UNKNOWN" for any other
 *           value. Never NULL.
 */
const char *distance_bucket_str(enum distance_bucket b)
{
	switch (b) {
	case DIST_NEAR: return "NEAR";
	case DIST_MID:  return "MID";
	case DIST_FAR:  return "FAR";
	default:        return "UNKNOWN";
	}
}
```

## src/inference.h
```c
#ifndef INFERENCE_H_
#define INFERENCE_H_

#include <stddef.h>

enum distance_bucket {
	DIST_NEAR = 0,
	DIST_MID = 1,
	DIST_FAR = 2,
	DIST_UNKNOWN = 3,
};

/* Classify a short window of RSSI samples (most recent last) into a
 * distance bucket. `n` is between 1 and INFERENCE_WINDOW_LEN.
 */
enum distance_bucket classify_distance(const float *rssi_window, size_t n);

const char *distance_bucket_str(enum distance_bucket b);

#endif /* INFERENCE_H_ */
```

## src/leds.c
```c
#include "leds.h"

#include <zephyr/drivers/gpio.h>
#include <zephyr/sys/printk.h>

/* nRF52840 DK aliases: led0..led3 */
#define LED_NEAR_NODE DT_ALIAS(led0)
#define LED_MID_NODE  DT_ALIAS(led1)
#define LED_FAR_NODE  DT_ALIAS(led2)

static const struct gpio_dt_spec led_near = GPIO_DT_SPEC_GET(LED_NEAR_NODE, gpios);
static const struct gpio_dt_spec led_mid  = GPIO_DT_SPEC_GET(LED_MID_NODE, gpios);
static const struct gpio_dt_spec led_far  = GPIO_DT_SPEC_GET(LED_FAR_NODE, gpios);

int leds_init(void)
{
	const struct gpio_dt_spec *leds[] = {&led_near, &led_mid, &led_far};

	for (size_t i = 0; i < ARRAY_SIZE(leds); i++) {
		if (!gpio_is_ready_dt(leds[i])) {
			printk("LED %zu device not ready\n", i);
			return -ENODEV;
		}
		int ret = gpio_pin_configure_dt(leds[i], GPIO_OUTPUT_INACTIVE);
		if (ret < 0) {
			return ret;
		}
	}
	return 0;
}

void leds_show_bucket(enum distance_bucket b)
{
	gpio_pin_set_dt(&led_near, b == DIST_NEAR);
	gpio_pin_set_dt(&led_mid, b == DIST_MID);
	gpio_pin_set_dt(&led_far, b == DIST_FAR);
}
```

## src/leds.h
```c
#ifndef LEDS_H_
#define LEDS_H_

#include "inference.h"

/* Configures led0/1/2 (DK aliases). Returns 0 on success. */
int leds_init(void);

/* Lights the LED for `b` (led0=near, led1=mid, led2=far) and turns the
 * others off.
 */
void leds_show_bucket(enum distance_bucket b);

#endif /* LEDS_H_ */
```

## src/model_weights.c
```c
/* Auto-generated from model_int8.tflite by model/extract_weights.py.
 * Trained model weights/quantization params, embedded directly - no TFLite Micro
 * runtime dependency. See inference.c for the matching forward pass.
 * Regenerate whenever the model is retrained on new data. */

#include "model_weights.h"

const float model_feature_mean[3] = { -73.75196075f, -73.75395203f, 1.508615494f };
const float model_feature_std[3]  = { 5.0278368f, 4.66024065f, 1.242407441f };

const float model_input_scale = 0.03244039416f;
const int32_t model_input_zero_point = -71;

/* Layer 1: 3 -> 8, ReLU */
static const int8_t l1_weights[24] = {-127, 26, -81, -127, -60, 24, 21, -127, -124, -19, -127, 59, 127, 115, 47, 127, 45, -68, -127, 109, 61, -12, 127, 27};
static const int32_t l1_bias[8] = {2575, 610, 4359, 1243, -22, 884, -560, 2425};
static const float l1_weight_scales[8] = {0.007261885796f, 0.006498846225f, 0.004901304841f, 0.00774505781f, 0.008190944791f, 0.00839486625f, 0.004335574806f, 0.008916405961f};
const float l1_act_scale = 0.03368854895f;
const int32_t l1_act_zero_point = -128;

/* Layer 2: 8 -> 8, ReLU */
static const int8_t l2_weights[64] = {-73, 55, 114, 118, 15, -104, 127, 27, -127, -101, 124, 97, 7, -68, 86, -23, -127, -5, -95, 57, 57, 62, -5, 86, -30, -64, -19, 113, -70, -6, -127, 22, 48, -8, 87, -91, -30, 127, -5, 106, 7, -3, 5, -26, 91, -12, 52, 127, 120, 109, 8, 57, 33, -39, -64, -127, -112, -71, -50, 22, 32, -49, 127, -52};
static const int32_t l2_bias[8] = {153, -1051, -558, 184, 3368, 964, -422, -829};
static const float l2_weight_scales[8] = {0.005333176814f, 0.004104533698f, 0.01095979754f, 0.005632106215f, 0.007679581176f, 0.009427763522f, 0.00712406775f, 0.003964781761f};
const float l2_act_scale = 0.05367370695f;
const int32_t l2_act_zero_point = -128;

/* Layer 3: 8 -> 3, no activation (argmax of logits == argmax of softmax) */
static const int8_t l3_weights[24] = {78, -46, 127, -106, -24, 66, -115, -47, -96, 30, -82, 68, 59, 45, -127, -23, 101, 4, -79, 16, -84, -127, 98, 28};
static const int32_t l3_bias[3] = {-1039, 930, -332};
static const float l3_weight_scales[3] = {0.007908917032f, 0.009380440228f, 0.00803366024f};

const struct model_weights g_model_weights = {
	.l1_w = l1_weights, .l1_b = l1_bias, .l1_w_scales = l1_weight_scales,
	.l1_act_scale = &l1_act_scale, .l1_act_zp = &l1_act_zero_point,
	.l2_w = l2_weights, .l2_b = l2_bias, .l2_w_scales = l2_weight_scales,
	.l2_act_scale = &l2_act_scale, .l2_act_zp = &l2_act_zero_point,
	.l3_w = l3_weights, .l3_b = l3_bias, .l3_w_scales = l3_weight_scales,
};
```

## src/model_weights.h
```c
#ifndef MODEL_WEIGHTS_H_
#define MODEL_WEIGHTS_H_

/*
 * Auto-generated weight/quantization data for the trained distance-bucket
 * classifier (3 -> 8 -> 8 -> 3, INT8, from model/model_int8.tflite).
 * See model_weights.c and inference.c.
 *
 * Regenerate by re-running model/train.py on a bigger/better dataset, then
 * re-running the weight-extraction step documented in model/README.md.
 */

#include <stdint.h>

#define MODEL_NUM_FEATURES 3
#define MODEL_L1_UNITS 8
#define MODEL_L2_UNITS 8
#define MODEL_NUM_CLASSES 3

extern const float model_feature_mean[MODEL_NUM_FEATURES];
extern const float model_feature_std[MODEL_NUM_FEATURES];
extern const float model_input_scale;
extern const int32_t model_input_zero_point;

struct model_weights {
	const int8_t *l1_w;    /* [MODEL_L1_UNITS][MODEL_NUM_FEATURES] */
	const int32_t *l1_b;   /* [MODEL_L1_UNITS] */
	const float *l1_w_scales; /* per-output-channel weight scale, [MODEL_L1_UNITS] */
	const float *l1_act_scale;
	const int32_t *l1_act_zp;

	const int8_t *l2_w;    /* [MODEL_L2_UNITS][MODEL_L1_UNITS] */
	const int32_t *l2_b;   /* [MODEL_L2_UNITS] */
	const float *l2_w_scales;
	const float *l2_act_scale;
	const int32_t *l2_act_zp;

	const int8_t *l3_w;    /* [MODEL_NUM_CLASSES][MODEL_L2_UNITS] */
	const int32_t *l3_b;   /* [MODEL_NUM_CLASSES] */
	const float *l3_w_scales;
};

extern const struct model_weights g_model_weights;

#endif /* MODEL_WEIGHTS_H_ */
```

## src/scanner.c
```c
#include "scanner.h"
#include "inference.h"
#include "leds.h"
#include "ble_result_svc.h"

#include <stdbool.h>
#include <string.h>
#include <zephyr/kernel.h>
#include <zephyr/sys/printk.h>
#include <zephyr/bluetooth/bluetooth.h>
#include <zephyr/bluetooth/hci.h>

/* Each nearby device gets its own RSSI window - mixing samples from
 * different physical devices into one shared window (the original,
 * simpler version of this file) corrupts the rolling mean/std features,
 * since consecutive "samples" could be from devices at completely
 * different distances. Small fixed-size table, LRU-evicted, since we're
 * only ever tracking a handful of nearby BLE devices at once.
 */
#define MAX_TRACKED_DEVICES 8

struct tracked_device {
	bt_addr_le_t addr;
	bool in_use;
	float window[INFERENCE_WINDOW_LEN];
	size_t window_len;
	size_t window_pos;
	int64_t last_seen_ms;
};

static struct tracked_device devices[MAX_TRACKED_DEVICES];

static struct tracked_device *find_or_alloc(const bt_addr_le_t *addr)
{
	struct tracked_device *oldest = NULL;

	for (int i = 0; i < MAX_TRACKED_DEVICES; i++) {
		if (devices[i].in_use && bt_addr_le_eq(&devices[i].addr, addr)) {
			return &devices[i];
		}
		if (!devices[i].in_use) {
			devices[i].in_use = true;
			devices[i].addr = *addr;
			devices[i].window_len = 0;
			devices[i].window_pos = 0;
			return &devices[i];
		}
		if (oldest == NULL || devices[i].last_seen_ms < oldest->last_seen_ms) {
			oldest = &devices[i];
		}
	}

	/* Table full: evict the least-recently-seen device. */
	oldest->addr = *addr;
	oldest->window_len = 0;
	oldest->window_pos = 0;
	return oldest;
}

static void push_sample(struct tracked_device *dev, float rssi)
{
	dev->window[dev->window_pos] = rssi;
	dev->window_pos = (dev->window_pos + 1) % INFERENCE_WINDOW_LEN;
	if (dev->window_len < INFERENCE_WINDOW_LEN) {
		dev->window_len++;
	}
}

static void device_found(const bt_addr_le_t *addr, int8_t rssi, uint8_t type,
			  struct net_buf_simple *ad)
{
	char addr_str[BT_ADDR_LE_STR_LEN];

	ARG_UNUSED(type);
	ARG_UNUSED(ad);

	bt_addr_le_to_str(addr, addr_str, sizeof(addr_str));

	if (strlen(TARGET_BEACON_MAC) > 0 &&
	    strncmp(addr_str, TARGET_BEACON_MAC, strlen(TARGET_BEACON_MAC)) != 0) {
		return;
	}

	struct tracked_device *dev = find_or_alloc(addr);

	dev->last_seen_ms = k_uptime_get();
	push_sample(dev, (float)rssi);

	/* dev->window is a circular buffer - classify_distance() needs it in
	 * chronological order (it reads index [n-1] as "the sample just
	 * pushed"), so reorder into a small stack copy before calling. Only
	 * INFERENCE_WINDOW_LEN elements, negligible cost next to the
	 * inference itself.
	 */
	float ordered[INFERENCE_WINDOW_LEN];
	for (size_t k = 0; k < dev->window_len; k++) {
		size_t idx = (dev->window_pos + INFERENCE_WINDOW_LEN - dev->window_len + k) %
			     INFERENCE_WINDOW_LEN;
		ordered[k] = dev->window[idx];
	}

	uint32_t t0 = k_cycle_get_32();
	enum distance_bucket bucket = classify_distance(ordered, dev->window_len);
	uint32_t t1 = k_cycle_get_32();
	uint32_t inference_us = k_cyc_to_us_floor32(t1 - t0);

	printk("RESULT,%s,%d,%s,%uus\n", addr_str, rssi, distance_bucket_str(bucket),
	       inference_us);

	/* LEDs/BLE-notify are a single shared indicator, so they can only
	 * ever reflect one device at a time - the one just classified
	 * (typically the most recently heard, or the sole TARGET_BEACON_MAC
	 * device if that's set).
	 */
	leds_show_bucket(bucket);
	ble_result_svc_notify(bucket);
}

int scanner_start(void)
{
	struct bt_le_scan_param scan_param = {
		.type     = BT_LE_SCAN_TYPE_ACTIVE,
		.options  = BT_LE_SCAN_OPT_NONE,
		.interval = BT_GAP_SCAN_FAST_INTERVAL_MIN,
		.window   = BT_GAP_SCAN_FAST_WINDOW,
	};
	int err = bt_le_scan_start(&scan_param, device_found);

	if (err) {
		printk("Start scanning failed (err %d)\n", err);
		return err;
	}
	printk("READY\n");
	return 0;
}
```

## src/scanner.h
```c
#ifndef SCANNER_H_
#define SCANNER_H_

/* window=8 found best in model/experiment.py's sweep (96.9% vs 92.6% at
 * window=5) - must match the `window` used to train the currently-linked
 * model_weights.c (see model/train.py's default).
 */
#define INFERENCE_WINDOW_LEN 8

/* Set this to the beacon's MAC address as printed by scanner_app /
 * log_to_csv.py during data collection, e.g. "AA:BB:CC:DD:EE:FF". Only
 * advertisements from this address feed the classifier - everything else
 * is ignored. Leave empty to classify whatever device is heard most
 * recently (fine for a quick demo, noisier with multiple BLE devices
 * around).
 */
#define TARGET_BEACON_MAC ""

int scanner_start(void);

#endif /* SCANNER_H_ */
```
